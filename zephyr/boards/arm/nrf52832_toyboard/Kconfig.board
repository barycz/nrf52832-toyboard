## zephyr/boards/arm/nrf52832_toyboard/Kconfig.board
```kconfig
# SPDX-License-Identifier: Apache-2.0

config BOARD_NRF52832_TOYBOARD
	bool "nRF52 toyboard"
	depends on SOC_NRF52832_QFAA
```

## zephyr/boards/arm/nrf52832_toyboard/Kconfig.defconfig
```kconfig
# SPDX-License-Identifier: Apache-2.0

if BOARD_NRF52832_TOYBOARD

config BOARD
	default "nrf52832_toyboard"

config BT_CTLR
	default BT

endif # BOARD_NRF52832_TOYBOARD
```

## zephyr/boards/arm/nrf52832_toyboard/nrf52832_toyboard_defconfig
```kconfig
# SPDX-License-Identifier: Apache-2.0

CONFIG_SOC_SERIES_NRF52X=y
CONFIG_SOC_NRF52832_QFAA=y
CONFIG_BOARD_NRF52832_TOYBOARD=y

# Enable MPU
CONFIG_ARM_MPU=y

# enable GPIO
CONFIG_GPIO=y

# Enable P0_21 as RST
CONFIG_GPIO_AS_PINRESET=y

# use internal RC 32kHz oscillator
CONFIG_CLOCK_CONTROL_NRF_K32SRC_RC=y
```
